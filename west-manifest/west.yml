## west-manifest/west.yml
```yaml
manifest:
  remotes:

  # Both Zephyr and renesas hal remotes are forks.
  # Because they contain not yet merged custom changes 
  # for the RA4E2 microcontroller USB peripheral
  # zephyr: PR draft: https://github.com/zephyrproject-rtos/zephyr/pull/108817
  # hal_renesas: PR is pending: https://github.com/zephyrproject-rtos/hal_renesas/pull/208
  # When merged the remotes will be changed to upstream

  - name: zephyrproject
    url-base: https://github.com/zephyrproject-rtos

  projects:
  - name: zephyr
    repo-path: zephyr
    remote: zephyrproject
    revision: pull/108817/head
    import:
      path-prefix: external
      name-allowlist:
      - cmsis_6
      - picolibc
      - segger
      - mcuboot
      - mbedtls
      - crypto
      - libmetal
      - littlefs
      - net-tools
      - tinycrypt
      - zcbor
      - zscilib
      - tf-psa-crypto
      - trusted-firmware-m
      - hal_renesas
```
